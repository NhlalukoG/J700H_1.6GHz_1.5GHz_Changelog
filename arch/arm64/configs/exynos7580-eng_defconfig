## arch/arm64/configs/exynos7580-eng_defconfig
```kconfig
# CONFIG_MUIC_RUSTPROOF_ON_USER is not set
#
# Kernel Performance Events and Counters
#
CONFIG_PERF_EVENTS=y
CONFIG_SLUB_DEBUG=y

#
# Kernel hacking
#
CONFIG_SLUB_DEBUG_ON=y
# CONFIG_DEBUG_KMEMLEAK is not set
CONFIG_DEBUG_PREEMPT=y
CONFIG_DEBUG_RT_MUTEXES=y
CONFIG_DEBUG_PI_LIST=y
CONFIG_DEBUG_SPINLOCK=y
CONFIG_DEBUG_MUTEXES=y
CONFIG_DEBUG_LOCK_ALLOC=y
CONFIG_PROVE_LOCKING=y
CONFIG_DEBUG_ATOMIC_SLEEP=y
CONFIG_DEBUG_STACK_USAGE=y
CONFIG_DEBUG_LIST=y
CONFIG_DEBUG_SG=y
CONFIG_SND_SOC_SAMSUNG_VERBOSE_DEBUG=y

#
# TIMA RKP CRED Protection
#
# CONFIG_RKP_KDP is not set
```
